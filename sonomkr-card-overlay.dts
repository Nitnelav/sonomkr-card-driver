// Definitions for SonoMKR Audio Card 

/dts-v1/;
/plugin/;

/ {
       compatible = "brcm,bcm2708";

       fragment@0 {
               target = <&i2s>;
               __overlay__ {
                       status = "okay";
               };
       };

       fragment@1 {
               target-path = "/";
               __overlay__ {
                       wm8782 {
                               #sound-dai-cells = <0>;
                               compatible = "wlf,wm8782";
                               status = "okay";
                       };
               };
       };

       fragment@2 {
               target = <&sound>;
               __overlay__ {
                       compatible = "sonomkr,card-wm8782";
                       i2s-controller = <&i2s>;
                       status = "okay";
               };
       };
};

